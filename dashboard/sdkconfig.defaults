## firmware/main/Kconfig.projbuild
```kconfig
menu "Example Configuration"

    config ENABLE_MEMORY_PROFILING
        bool "Enable Memory Profiling"
        default n
        help
            Enable this option to include memory profiling features in the example.
            This will allow you to monitor memory usage during runtime.

endmenu

menu "MedReminder"

    config MEDREMINDER_TZ
        string "Timezone (POSIX TZ string)"
        default "CST6CDT,M3.2.0,M11.1.0"
        help
            Local timezone for the clock. Default US Central with DST.

    choice MEDREMINDER_ROLE
        prompt "Device role"
        default MEDREMINDER_ROLE_MAIN
        help
            Set per board in boards/<board>/sdkconfig.defaults.

        config MEDREMINDER_ROLE_MAIN
            bool "Main unit: schedule editing, dose accessories in Apple Home"
        config MEDREMINDER_ROLE_NODE
            bool "Node: shows the doses; no dose accessories (the main unit has them)"
    endchoice

    choice MEDREMINDER_UI_LAYOUT
        prompt "Home screen center layout"
        default MEDREMINDER_UI_LAYOUT_RECT
        help
            Set per board in boards/<board>/sdkconfig.defaults.

        config MEDREMINDER_UI_LAYOUT_RECT
            bool "Rectangular: full-width pill column, time on the top line"
        config MEDREMINDER_UI_LAYOUT_ROUND
            bool "Round 240x240, no touch: next dose large in a colored ring (ui_round.c)"
    endchoice

    config MEDREMINDER_DOSE_TEST
        bool "Test dose schedule (first alert after 1 min)"
        default n
        help
            Replaces the dose times with a schedule starting when the clock is set: the first dose
            due immediately, then one every 2 minutes; overdue after 1 minute, alert repeat every
            minute. Reboot to restart it. For testing overdue alerts without waiting hours.

    config MEDREMINDER_NTP_SERVER
        string "NTP server"
        default "pool.ntp.org"
        help
            Reached over Thread through the border routers' NAT64 (needs OPENTHREAD_DNS64_CLIENT).

endmenu
```
